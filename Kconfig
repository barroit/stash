## Kconfig
```kconfig
# SPDX-License-Identifier: GPL-3.0-or-later

source "scripts/Kconfig.include"

mainmenu "$(repo-name)/$(build-host) $(repo-version) Configuration"

source "scripts/Kconfig.compile"

source "scripts/Kconfig.feature"
```

## scripts/Kconfig.include
```kconfig
# SPDX-License-Identifier: GPL-3.0-or-later

$(warn-off)

repo_info := $(repo-info)
build_info := $(build-info)
cc_info := $(cc-info)
ld_info := $(ld-info)

repo-name := $(column,$(repo_info),1)
repo-version := $(column,$(repo_info),2)

build-arch := $(column,$(build_info),1)
build-platform := $(column,$(build_info),2)
build-host := $(build-arch)-$(build-platform)

cc := $(column,$(cc_info),1)
ld := $(column,$(ld_info),1)

config REPO_NAME
	def_string $(repo-name)

config REPO_VERSION
	def_string $(repo-version)

config BUILD_ARCH
	def_string $(build-arch)

config BUILD_PLATFORM
	def_string $(build-platform)

config CC_PROGRAM
	def_string $(cc)

config CC_ID
	def_string $(column,$(cc_info),2)

config CC_VERSION
	def_int $(column,$(cc_info),3)

config CC_NAME
	def_string $(column,$(cc_info),4)

config LD_PROGRAM
	def_string $(ld)

config LD_ID
	def_string $(column,$(ld_info),2)

config LD_VERSION
	def_int $(column,$(ld_info),3)

config LD_NAME
	def_string $(column,$(ld_info),4)

config CC_IS_CLANG
	def_bool CC_NAME = "Clang"

config CC_IS_GCC
	def_bool CC_NAME = "GCC"
```
